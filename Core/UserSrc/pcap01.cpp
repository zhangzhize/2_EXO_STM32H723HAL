#include "pcap01.hpp"

#define PCAP01_SRAM_COMM_WRITE 0x90 // b'1001 0000
#define PCAP01_SRAM_COMM_READ 0x10  // b'0001 0000

static const uint8_t PCap01_standard_firmware[4096] = {
    0x0, 0x0, 0x0, 0x62, 0x63, 0x0, 0x65, 0xBE, 0x1, 0x20, 0x26, 0x42, 0x5C, 0x48, 0xA0, 0x3,
    0x22, 0x15, 0x20, 0x31, 0xA1, 0x3, 0x22, 0x15, 0x20, 0x31, 0x84, 0x1, 0x23, 0x94, 0x1, 0x0,
    0x0, 0x0, 0x0, 0x0, 0x20, 0x0B, 0x43, 0x58, 0xC0, 0xFE, 0x43, 0xC0, 0x44, 0x7A, 0x7E, 0x20,
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    0xFF, 0xFF, 0xFF, 0xFF, 0xFF, 0xFF, 0xFF, 0xFF, 0xFF, 0xFF, 0xFF, 0xFF, 0xFF, 0xFF, 0xFF, 0xFF};

// 【优化 1】：加上 static const
static const uint32_t PCap01_standard_config_reg[11] = {
    0x4200FF, /* 关闭OTP模式、开启程序读保护 */
    0x201022, /* 后8位设置内部晶振频率，0x35=10kHz,0x22=50kHz（推荐）,0x13=100kHz,0x04=200kHz */

//	0x0F670B,
     0x0F470B, /* 使能PC0-PC3，选择单电容浮地模式，关闭差动电容对称充放电，开启外部补偿，开启内部补偿，选择10K内部放电电阻 ############### */
    
    0x002001, /** SEQ_TIME, 20*2^(s+1)us; CMEAS_FAKE; C_AVRG */
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    0xFF000F,
    0x180047 /* 1.8v核心电压，选择标准模式 */
};

PCAP01::PCAP01() {}

inline void PCAP01::csLow()
{
    if (_cs_port)
        HAL_GPIO_WritePin(_cs_port, _cs_pin, GPIO_PIN_RESET);
}

inline void PCAP01::csHigh()
{
    if (_cs_port)
        HAL_GPIO_WritePin(_cs_port, _cs_pin, GPIO_PIN_SET);
}

uint8_t PCAP01::spiReadWriteByte(uint8_t txdata)
{
    uint8_t rxdata = 0;
    HAL_SPI_TransmitReceive(_hspi, &txdata, &rxdata, 1, 100);
    return rxdata;
}

PCAP01_ERROR PCAP01::begin(SPI_HandleTypeDef *hspi, GPIO_TypeDef *cs_port, uint16_t cs_pin)
{
    if (!hspi || !cs_port)
        return PCAP01_ERROR::INIT_ERROR;

    _hspi = hspi;
    _cs_port = cs_port;
    _cs_pin = cs_pin;

    csHigh();

    sendOpcode(KOpcodeReset);
    HAL_Delay(2);

    PCAP01_ERROR err = commTest();
    if (err != PCAP01_ERROR::OK)
        return err;

    err = writeStdFirmware();
    if (err != PCAP01_ERROR::OK)
        return err;

    writeStdConfig();

    writeRegister(KRunbitRegAddr, KRunbitRegData);
    sendOpcode(KOpcodePartialReset);
    HAL_Delay(2);

    initLowPassFilter(1.5f, 40.0f);

    return PCAP01_ERROR::OK;
}

void PCAP01::sendOpcode(uint8_t opcode)
{
    csLow();
    spiReadWriteByte(opcode);
    csHigh();
}

uint8_t PCAP01::sramComm(uint8_t comm_type, uint16_t addr, uint8_t data)
{
    uint8_t read_result = 0;

    uint8_t tx_buf[3];
    tx_buf[0] = comm_type | (addr >> 8);
    tx_buf[1] = addr & 0xFF;
    tx_buf[2] = (comm_type == PCAP01_SRAM_COMM_WRITE) ? data : 0xFF;

    uint8_t rx_buf[3] = {0};

    csLow();
    HAL_SPI_TransmitReceive(_hspi, tx_buf, rx_buf, 3, 100);
    csHigh();

    if (comm_type == PCAP01_SRAM_COMM_READ)
    {
        read_result = rx_buf[2];
    }

    return read_result;
}

void PCAP01::writeRegister(uint8_t reg_addr, uint32_t data)
{
    uint8_t tx_buf[4];
    tx_buf[0] = KCmdWriteReg | reg_addr;
    tx_buf[1] = (data >> 16) & 0xFF;
    tx_buf[2] = (data >> 8) & 0xFF;
    tx_buf[3] = data & 0xFF;

    csLow();
    HAL_SPI_Transmit(_hspi, tx_buf, 4, 100);
    csHigh();
}

uint32_t PCAP01::readRawRegister(uint8_t reg_addr)
{
    uint8_t tx_buf[4] = {(uint8_t)(KCmdReadReg | reg_addr), 0xFF, 0xFF, 0xFF};
    uint8_t rx_buf[4] = {0};

    csLow();
    HAL_SPI_TransmitReceive(_hspi, tx_buf, rx_buf, 4, 100);
    csHigh();

    return (rx_buf[1] << 16) | (rx_buf[2] << 8) | rx_buf[3];
}

float PCAP01::readRegister(uint8_t reg_addr, uint8_t fractional_bits)
{
    uint32_t raw_data = readRawRegister(reg_addr);
    return (float)raw_data / (1 << fractional_bits);
}

void PCAP01::writeStdConfig(void)
{
    for (uint8_t i = 0; i < 11; i++)
    {
        writeRegister(i, PCap01_standard_config_reg[i]);
        HAL_Delay(1);
    }
}

PCAP01_ERROR PCAP01::commTest(void)
{
    uint8_t ret = 0x00;
    uint8_t retry_count = 0;

    while (ret != 0x55)
    {
        sramComm(PCAP01_SRAM_COMM_WRITE, 0x0D, 0x55);
        HAL_Delay(1);
        ret = sramComm(PCAP01_SRAM_COMM_READ, 0x0D, 0xFF);

        retry_count++;
        if (retry_count > 10)
        {
            return PCAP01_ERROR::COMM_TEST_FAILED;
        }
        HAL_Delay(50);
    }
    return PCAP01_ERROR::OK;
}

PCAP01_ERROR PCAP01::writeStdFirmware(void)
{
    uint8_t ret = 0xBB;

    for (uint16_t addr = 0; addr < 4096; addr++)
    {
        uint8_t retry_count = 0;

        while (PCap01_standard_firmware[addr] != ret)
        {
            sramComm(PCAP01_SRAM_COMM_WRITE, addr, PCap01_standard_firmware[addr]);
            ret = sramComm(PCAP01_SRAM_COMM_READ, addr, 0xFF);

            retry_count++;
            if (retry_count > 5)
            {
                return PCAP01_ERROR::FIRMWARE_LOAD_FAILED;
            }
        }
        ret = 0xBB;
    }

    for (uint16_t addr = 0; addr < 30; addr++)
    {
        sramComm(PCAP01_SRAM_COMM_READ, addr, 0xFF);
    }

    return PCAP01_ERROR::OK;
}

void PCAP01::initLowPassFilter(float cutoff_freq, float sampling_freq)
{
    if (cutoff_freq >= sampling_freq / 2.0f)
    {
        filter_alpha_ = 1.0f;
    }
    else
    {
        float dt = 1.0f / sampling_freq;
        float rc = 1.0f / (2.0f * 3.1415926535f * cutoff_freq);
        filter_alpha_ = dt / (rc + dt);
    }

    for (int i = 0; i < MAX_MATRIX_NODES; i++)
    {
        is_filter_first_run_[i] = true;
        filtered_data_[i] = 0.0f;
    }
}

float PCAP01::applyLowPassFilter(uint8_t node_index, float raw_capacitance)
{
    if (node_index >= MAX_MATRIX_NODES)
        return raw_capacitance;

    if (is_filter_first_run_[node_index])
    {
        filtered_data_[node_index] = raw_capacitance;
        is_filter_first_run_[node_index] = false;
    }
    else
    {
        filtered_data_[node_index] = filter_alpha_ * raw_capacitance + (1.0f - filter_alpha_) * filtered_data_[node_index];
    }

    return filtered_data_[node_index];
}
